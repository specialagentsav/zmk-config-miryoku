// Copyright 2022 Lukas Kucera
// https://github.com/kucera-lukas/zmk-config

#include <behaviors.dtsi>
#include <dt-bindings/zmk/keys.h>

#define MASK_MODS(NAME, MODS, BINDING) \
/ { \
  behaviors { \
    NAME: NAME { \
      compatible = "zmk,behavior-mod-morph"; \
      label = U_STRINGIFY(NAME); \
      #binding-cells = <0>; \
      bindings = <BINDING>, <BINDING>; \
      mods = <MODS>; \
    }; \
  }; \
};

MASK_MODS(masked_home, (MOD_LCTL), &kp HOME)
MASK_MODS(masked_end, (MOD_LCTL), &kp END)
