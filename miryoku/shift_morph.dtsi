// Copyright 2022 Lukas Kucera
// https://github.com/kucera-lukas/miryoku

#include <behaviors.dtsi>
#include <dt-bindings/zmk/keys.h>

#define SHIFT_MORPH(NAME, BINDING, SHIFT_BINDING) \
/ { \
  behaviors { \
    NAME: NAME { \
      compatible = "zmk,behavior-mod-morph"; \
      label = U_STRINGIFY(NAME); \
      #binding-cells = <0>; \
      bindings = <BINDING>, <SHIFT_BINDING>; \
      mods = <(MOD_LSFT|MOD_RSFT)>; \
    }; \
  }; \
};

/ {
  behaviors {
    u_caps_word: u_caps_word {
      compatible = "zmk,behavior-caps-word";
      label = "U_CAPS_WORD";
      #binding-cells = <0>;
      mods = <MOD_LSFT>;
      continue-list = <A B C D E F G H I J K L M N O P Q R S T U V W X Y Z N0 N1 N2 N3 N4 N5 N6 N7 N8 N9 BACKSPACE DELETE COMMA UNDERSCORE EQUAL MINUS LEFT RIGHT DOLLAR>;
    };
  };
};

SHIFT_MORPH(u_caps_word_caps, &u_caps_word, &kp CAPS)
