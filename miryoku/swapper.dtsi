// Copyright 2022 Lukas Kucera
// https://github.com/kucera-lukas/zmk-config

#include <behaviors.dtsi>
#include <dt-bindings/zmk/keys.h>

#include "hold_tap.h"

#include "hold_tap.dtsi"

/ {
  behaviors {
    alt_tab_swapper: alt_tab_swapper {
      compatible = "zmk,behavior-tri-state";
      label = "alt_tab_swapper";
      #binding-cells = <0>;
      bindings = <&kt LALT>, <&kp TAB>, <&kt LALT>;
      ignored-key-positions = <26>;
    };

    gui_tab_swapper: gui_tab_swapper {
      compatible = "zmk,behavior-tri-state";
      label = "gui_tab_swapper";
      #binding-cells = <0>;
      bindings = <&kt LGUI>, <&kp TAB>, <&kt LGUI>;
      ignored-key-positions = <26>;
    };
  };
};

HOLD_TAP_FUNCTION(alt_gui_tab_swapper, &gui_tab_swapper, &alt_tab_swapper)
