// Copyright 2022 Lukas Kucera
// https://github.com/kucera-lukas/zmk-config

#include <behaviors.dtsi>
#include <dt-bindings/zmk/ext_power.h>
#include <dt-bindings/zmk/keys.h>
#include <dt-bindings/zmk/outputs.h>
#include <dt-bindings/zmk/rgb.h>

#include "mask_mods.h"

#include "mask_mods.dtsi"

#define HOLD_TAP_FUNCTION(NAME, HOLD_BINDING, BINDING) \
/ { \
  behaviors { \
    NAME: NAME { \
      compatible = "zmk,behavior-hold-tap"; \
      label = U_STRINGIFY(NAME); \
      #binding-cells = <2>; \
      tapping_term_ms = <U_TAPPING_TERM>; \
      quick-tap-ms = <U_QUICK_TAP_MS>; \
      flavor = "tap-preferred"; \
      bindings = <HOLD_BINDING>, <BINDING>; \
    }; \
  }; \
};

#define HOLD_TAP_KP_FUNCTION(NAME, HOLD_BINDING) HOLD_TAP_FUNCTION(NAME, HOLD_BINDING, &kp)

HOLD_TAP_FUNCTION(hold_tap, &kp, &kp)
HOLD_TAP_FUNCTION(out_hold_tap, &out, &out)
HOLD_TAP_FUNCTION(rgb_hold_tap, &rgb_ug, &rgb_ug)
HOLD_TAP_FUNCTION(ext_power_hold_tap, &ext_power, &ext_power)

#define NAV_HOLD_TAP_FUNCTION(NAME, HOLD_BINDING, BINDING) \
/ { \
  behaviors { \
    NAME: NAME { \
      compatible = "zmk,behavior-hold-tap"; \
      label = U_STRINGIFY(NAME); \
      #binding-cells = <2>; \
      tapping_term_ms = <220>; \
      quick-tap-ms = <220>; \
      hold-trigger-key-positions = <0>; \
      flavor = "tap-preferred"; \
      bindings = <HOLD_BINDING>, <BINDING>; \
    }; \
  }; \
};

NAV_HOLD_TAP_FUNCTION(nav_hold_tap, &kp, &kp)
NAV_HOLD_TAP_FUNCTION(nav_masked_home_hold_tap, U_MASKED_HOME, &kp)
NAV_HOLD_TAP_FUNCTION(nav_masked_end_hold_tap, U_MASKED_END, &kp)

#define HOLD_TAP(hold, tap) &hold_tap hold tap
#define OUT_HOLD_TAP(hold, tap) &out_hold_tap hold tap
#define RGB_HOLD_TAP(hold, tap) &rgb_hold_tap hold tap
#define EXT_POWER_HOLD_TAP(hold, tap) &ext_power_hold_tap hold tap

#define NAV_HOLD_TAP(hold, tap) &nav_hold_tap hold tap
#define NAV_MASKED_HOME_TAP(tap) &nav_masked_home_hold_tap 0 tap
#define NAV_MASKED_END_TAP(tap) &nav_masked_end_hold_tap 0 tap
