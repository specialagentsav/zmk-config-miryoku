// Copyright 2022 Lukas Kucera
// https://github.com/kucera-lukas/zmk-config

#include <behaviors.dtsi>
#include <dt-bindings/zmk/keys.h>

#define SHIFT_FUNCTION(NAME, BINDING, SHIFT_BINDING) \
/ { \
  behaviors { \
    NAME: NAME { \
      compatible = "zmk,behavior-mod-morph"; \
      label = U_STRINGIFY(NAME); \
      #binding-cells = <0>; \
      bindings = <BINDING>, <SHIFT_BINDING>; \
      mods = <(MOD_LSFT|MOD_RSFT)>; \
    }; \
  }; \
};
