// Copyright 2022 Lukas Kucera
// https://github.com/kucera-lukas/zmk-config

/ {
  behaviors {
    layer_tap: layer_tap {
      compatible = "zmk,behavior-hold-tap";
      label = "LAYER_TAP";
      #binding-cells = <2>;
      flavor = "balanced";
      tapping_term_ms = <U_TAPPING_TERM>;
      quick-tap-ms = <U_QUICK_TAP_MS>;
      bindings = <&mo>, <&kp>;
    };

    layer_skq: layer_skq {
      compatible = "zmk,behavior-hold-tap";
      label = "LAYER_SKQ";
      #binding-cells = <2>;
      flavor = "balanced";
      tapping_term_ms = <U_TAPPING_TERM>;
      quick-tap-ms = <U_QUICK_TAP_MS>;
      bindings = <&mo>, <&skq>;
    };
  };
};
