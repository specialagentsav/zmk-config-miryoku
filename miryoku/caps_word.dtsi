// Copyright 2022 Lukas Kucera
// https://github.com/kucera-lukas/zmk-config

#include "hold_tap.h"

#include "hold_tap.dtsi"

/ {
  behaviors {
    u_caps_word: u_caps_word {
      compatible = "zmk,behavior-caps-word";
      label = "u_caps_word";
      #binding-cells = <0>;
      mods = <MOD_LSFT>;
      continue-list = <A B C D E F G H I J K L M N O P Q R S T U V W X Y Z N0 N1 N2 N3 N4 N5 N6 N7 N8 N9 BACKSPACE DELETE COMMA UNDERSCORE EQUAL MINUS LEFT RIGHT DOLLAR>;
    };
  };
};

HOLD_TAP_FUNCTION(caps_word_caps, &kp, &u_caps_word)
